## config/boards/arm/vir72/Kconfig.board
```kconfig
# Copyright (c) 2021 Nick Winans
# SPDX-License-Identifier: MIT

config BOARD_VIR72
	bool "virgo72"
	depends on SOC_NRF52840_QIAA
```

## config/boards/shields/vir72/Kconfig.defconfig
```kconfig
# Copyright (c) 2021 Nick Winans
# SPDX-License-Identifier: MIT

if BOARD_VIRGO72

config ZMK_KEYBOARD_NAME
	default "virgo72"

if USB_DEVICE_STACK

config USB_NRFX
	default y

endif # USB_DEVICE_STACK

config BT_CTLR
	default BT

config ZMK_BLE
	default y

config ZMK_USB
	default y

endif # BOARD_VIRGO72
```
